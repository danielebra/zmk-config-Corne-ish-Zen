## config/west.yml
```yaml
manifest:
  remotes:
    - name: zmkfirmware
      url-base: https://github.com/zmkfirmware
      # url-base: https://github.com/danielebra
  projects:
    - name: zmk
      remote: zmkfirmware
      revision: main
      # revision: Board-Corne-ish-Zen-dedicated-work-queue
      import: app/west.yml
  self:
    path: config
```
